## pump_node/main/Kconfig.projbuild
```kconfig
menu "Pump Board"

    config PUMP_ENABLE_NEOPIXEL
        bool "Enable NeoPixel status LED"
        default y
        help
            WS2812 status LED(s) via esp-idf led_strip.

    config PUMP_NEOPIXEL_GPIO
        int "NeoPixel (WS2812) GPIO"
        depends on PUMP_ENABLE_NEOPIXEL
        range 0 21
        default 7
        help
            Data pin (SuperMini default GPIO 7 — LoRa uses 20/21).

    config PUMP_NEOPIXEL_COUNT
        int "NeoPixel count"
        depends on PUMP_ENABLE_NEOPIXEL
        range 1 16
        default 11
        help
            Number of LEDs on the status strip (linear bar).

    config PUMP_ENABLE_BUTTON
        bool "Enable local button"
        default y
        help
            One button on GPIO 0 (default). Set Stop GPIO to −1 for single-button
            wiring; hold ~5s on that button replaces “both buttons” for BLE pair.

    config PUMP_BUTTON_START_GPIO
        int "Button GPIO"
        depends on PUMP_ENABLE_BUTTON
        range 0 21
        default 0
        help
            Active-low to GND. ~1s hold toggles pump; longer hold = pair/factory.

    config PUMP_BUTTON_STOP_GPIO
        int "Stop button GPIO (−1 = not wired)"
        depends on PUMP_ENABLE_BUTTON
        range -1 21
        default -1
        help
            Optional second button. −1 = one button only (buzzer on GPIO 1).

    config PUMP_BUTTON_ACTIVE_LOW
        bool "Buttons are active low"
        depends on PUMP_ENABLE_BUTTON
        default y
        help
            Buttons to GND with internal pull-up (inverted).

    config PUMP_ACTION_HOLD_MS
        int "Hold Start or Stop to actuate pump (ms)"
        depends on PUMP_ENABLE_BUTTON
        range 200 5000
        default 1000
        help
            Center LED expands while held; action fires at threshold.

    config PUMP_PAIRING_HOLD_MS
        int "Hold both buttons to enter BLE pairing (ms)"
        depends on PUMP_ENABLE_BUTTON
        range 1000 15000
        default 5000

    config PUMP_FACTORY_RESET_EXTRA_MS
        int "Extra hold after BLE pair for factory reset (ms)"
        depends on PUMP_ENABLE_BUTTON
        range 5000 60000
        default 10000
        help
            Keep holding Start+Stop after the 5s BLE-pair cue. Red progress
            fills for this long, then factory reset + reboot. Hard to trigger
            by accident (default 5s pair + 10s = 15s total).

    config PUMP_PAIRING_TIMEOUT_MS
        int "Pairing window timeout (ms)"
        range 10000 300000
        default 60000

    config PUMP_ENABLE_BUZZER
        bool "Enable buzzer"
        default y
        help
            Active buzzer on the kitchen-gas-alarm board (GPIO HIGH = on).

    config PUMP_BUZZER_GPIO
        int "Buzzer GPIO"
        depends on PUMP_ENABLE_BUZZER
        range 0 21
        default 1

    config PUMP_RELAY_START_GPIO
        int "Starter relay A / START GPIO (−1 = unassigned)"
        range -1 21
        default 4
        help
            Momentary START output. −1 = logical pump only (no coil).

    config PUMP_RELAY_STOP_GPIO
        int "Starter relay B / STOP GPIO (−1 = unassigned)"
        range -1 21
        default 5
        help
            Momentary STOP output. −1 = unassigned.

    config PUMP_ENABLE_LORA
        bool "Enable RA-02 LoRa (tank link)"
        default y

    config PUMP_LORA_SCK_GPIO
        int "LoRa SCK GPIO"
        depends on PUMP_ENABLE_LORA
        default 8

    config PUMP_LORA_MOSI_GPIO
        int "LoRa MOSI GPIO"
        depends on PUMP_ENABLE_LORA
        default 10

    config PUMP_LORA_MISO_GPIO
        int "LoRa MISO GPIO"
        depends on PUMP_ENABLE_LORA
        default 21

    config PUMP_LORA_CS_GPIO
        int "LoRa NSS/CS GPIO"
        depends on PUMP_ENABLE_LORA
        default 20

    config PUMP_LORA_RST_GPIO
        int "LoRa RESET GPIO"
        depends on PUMP_ENABLE_LORA
        default 9

    config PUMP_LORA_DIO0_GPIO
        int "LoRa DIO0 GPIO"
        depends on PUMP_ENABLE_LORA
        default 6

    config PUMP_LORA_FREQ_HZ
        int "LoRa frequency (Hz)"
        depends on PUMP_ENABLE_LORA
        default 433000000

    config PUMP_TANK_PAIR_TIMEOUT_MS
        int "Tank LoRa pair window (ms)"
        depends on PUMP_ENABLE_LORA
        range 10000 300000
        default 60000

    config PUMP_TANK_STALE_SEC
        int "Tank offline after no packet (seconds)"
        depends on PUMP_ENABLE_LORA
        range 10 7200
        default 1500
        help
            Mark tank out of range if no LoRa packet within this window
            (about 2.5× the default 600s heartbeat).

    config PUMP_RELAY_ACTIVE_HIGH
        bool "Relays active high"
        default y
        help
            GPIO HIGH energizes the relay coil (common for transistor drivers).

    config PUMP_RELAY_PULSE_MS
        int "Start/Stop pulse width (ms)"
        range 50 2000
        default 400
        help
            How long Start/Stop relays stay closed for a two-button starter.

endmenu
```

## pump_node/sdkconfig.defaults
```kconfig
# ESP32-C3 fresh board — USB Serial/JTAG
CONFIG_ESP_CONSOLE_USB_SERIAL_JTAG=y

CONFIG_ESPTOOLPY_FLASHSIZE_4MB=y
CONFIG_PARTITION_TABLE_CUSTOM=y
CONFIG_PARTITION_TABLE_CUSTOM_FILENAME="partitions_ota.csv"
CONFIG_PARTITION_TABLE_FILENAME="partitions_ota.csv"
CONFIG_BT_NIMBLE_ATT_PREFERRED_MTU=512

CONFIG_BT_ENABLED=y
CONFIG_BT_BLUEDROID_ENABLED=n
CONFIG_BT_NIMBLE_ENABLED=y
CONFIG_BT_NIMBLE_GAP_SERVICE=y
CONFIG_BT_NIMBLE_MAX_CONNECTIONS=5

# Fresh C3 pin map (see README). Relays unassigned until wired.
CONFIG_PUMP_ENABLE_NEOPIXEL=y
CONFIG_PUMP_NEOPIXEL_GPIO=20
CONFIG_PUMP_NEOPIXEL_COUNT=11
CONFIG_PUMP_ENABLE_BUTTON=y
CONFIG_PUMP_BUTTON_START_GPIO=0
CONFIG_PUMP_BUTTON_STOP_GPIO=1
CONFIG_PUMP_BUTTON_ACTIVE_LOW=y
CONFIG_PUMP_PAIRING_HOLD_MS=5000
CONFIG_PUMP_PAIRING_TIMEOUT_MS=60000
CONFIG_PUMP_ENABLE_BUZZER=y
CONFIG_PUMP_BUZZER_GPIO=21
CONFIG_PUMP_RELAY_START_GPIO=-1
CONFIG_PUMP_RELAY_STOP_GPIO=-1
CONFIG_PUMP_RELAY_ACTIVE_HIGH=y
CONFIG_PUMP_RELAY_PULSE_MS=400

CONFIG_PUMP_ENABLE_LORA=y
CONFIG_PUMP_LORA_SCK_GPIO=10
CONFIG_PUMP_LORA_MOSI_GPIO=3
CONFIG_PUMP_LORA_MISO_GPIO=2
CONFIG_PUMP_LORA_CS_GPIO=5
CONFIG_PUMP_LORA_RST_GPIO=4
CONFIG_PUMP_LORA_DIO0_GPIO=8
CONFIG_PUMP_LORA_FREQ_HZ=433000000
```

## tank_node/main/Kconfig.projbuild
```kconfig
menu "TankLink Tank Node"

    config TANK_FLOAT_FULL_GPIO
        int "Float FULL GPIO (HIGH = full / disconnect)"
        range 0 21
        default 4

    config TANK_ENABLE_EMPTY_FLOAT
        bool "Enable almost-empty float switch"
        default y
        help
            HIGH = almost empty or disconnect (fail-safe). Default D3/GPIO5.

    config TANK_FLOAT_EMPTY_GPIO
        int "Float ALMOST EMPTY GPIO (HIGH = empty / disconnect)"
        depends on TANK_ENABLE_EMPTY_FLOAT
        range 0 21
        default 5

    config TANK_BUTTON_GPIO
        int "Button GPIO (to GND, active low)"
        range 0 21
        default 3

    config TANK_LED_GPIO
        int "Status LED GPIO"
        range 0 21
        default 7
        help
            Default D5/GPIO7. Do not use D4/GPIO6 (MTCK) — ROM JTAG pull-up
            faintly lights the LED at every reset before app_main runs.

    config TANK_BAT_ADC_GPIO
        int "Battery ADC GPIO"
        range 0 21
        default 2

    config TANK_LORA_SCK_GPIO
        int "LoRa SCK GPIO"
        default 8
        help
            XIAO D8/GPIO8 (default SPI SCK). Add 10 kΩ pull-up to 3V3 so boot
            strap stays HIGH (Seeed + SX1278 on C3 guidance).

    config TANK_LORA_MISO_GPIO
        int "LoRa MISO GPIO"
        default 21
        help
            Must NOT be GPIO9/D9 (BOOT). SX1278 pulls MISO low at power-up.

    config TANK_LORA_MOSI_GPIO
        int "LoRa MOSI GPIO"
        default 10

    config TANK_LORA_CS_GPIO
        int "LoRa NSS/CS GPIO"
        default 20
        help
            10 kΩ pull-up to 3V3 required (boot + deep sleep).

    config TANK_LORA_RST_GPIO
        int "LoRa RESET GPIO (-1 = 10k to 3V3 only)"
        range -1 21
        default 9
        help
            Default D9/GPIO9. Idle-high is fine for normal boot; hold BOOT to
            flash. Use -1 only if RESET is hard-wired high with 10 kΩ.

    config TANK_LORA_DIO0_GPIO
        int "LoRa DIO0 GPIO (-1 = unused)"
        range -1 21
        default 6
        help
            Default D4/GPIO6 (swapped with LED). IRQ also polled over SPI.
            Weak ROM pull-up on MTCK is fine for DIO0 input.

    config TANK_LORA_FREQ_HZ
        int "LoRa frequency (Hz)"
        default 433000000

    config TANK_DEMO_NO_SLEEP
        bool "Stay awake (demo / USB monitor)"
        default n
        help
            Skip deep sleep and loop heartbeats so USB-Serial/JTAG stays connected.

    config TANK_HEARTBEAT_SEC
        int "Heartbeat / max sleep interval (seconds)"
        range 5 86400
        default 300
        help
            Deep-sleep timer wake so the pump sees a periodic alive status.
            In demo no-sleep mode this is the loop period instead.

    config TANK_BUTTON_HOLD_MS
        int "Button hold to restart pairing (ms)"
        range 1000 15000
        default 5000
        help
            Must be clearly longer than a short press used for status TX / BLE OTA.
            Default 5s so a firm press for OTA is not mistaken for LoRa re-pair.

    config TANK_BUTTON_AWAKE_MS
        int "Stay awake after short button press (ms)"
        range 0 60000
        default 10000
        help
            After a short-press status TX, remain awake this long if BLE OTA window is not used
            (hold-to-pair still works). Prefer TANK_BLE_OTA_WINDOW_MS when paired.

    config TANK_BLE_OTA_WINDOW_MS
        int "BLE OTA advertise window after short press (ms)"
        range 10000 600000
        default 10000
        help
            After a paired short-press status TX, advertise BLE for this long so the phone
            can push a firmware update. Hold-to-pair still works if pressed during the window.

    config TANK_PAIR_WINDOW_MS
        int "Pairing mode timeout (ms)"
        range 10000 300000
        default 30000
        help
            After hold-to-pair, flash and retry PAIR until ACK, cancel, or this timeout.

    config TANK_TX_RETRIES
        int "LoRa TX attempts (until ACK)"
        range 1 8
        default 5
        help
            Each attempt: send packet, wait for pump ACK. Sleep after success or exhaustion.

    config TANK_ACK_TIMEOUT_MS
        int "LoRa ACK wait timeout per attempt (ms)"
        range 100 5000
        default 800

endmenu
```
