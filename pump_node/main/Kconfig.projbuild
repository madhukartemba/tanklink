## pump_node/main/Kconfig.projbuild
```kconfig
menu "Pump Board"

    config PUMP_HW_REV
        int "Pump board revision"
        range 1 255
        default 1
        help
            Hardware revision of the pump board this firmware is built for.
            Reported to the app in Info. Bump it when the board changes in a
            way that needs different firmware (pins, parts), and list the
            revisions a release supports in its firmware manifest.

    config PUMP_ENABLE_NEOPIXEL
        bool "Enable NeoPixel status LED"
        default y
        help
            WS2812 status LED(s) via esp-idf led_strip.

    config PUMP_NEOPIXEL_GPIO
        int "NeoPixel (WS2812) GPIO"
        depends on PUMP_ENABLE_NEOPIXEL
        range 0 21
        default 20
        help
            Data pin (fresh C3 board default GPIO 20).

    config PUMP_NEOPIXEL_COUNT
        int "NeoPixel count"
        depends on PUMP_ENABLE_NEOPIXEL
        range 1 16
        default 11
        help
            Number of LEDs on the status strip (linear bar).

    config PUMP_ENABLE_BUTTON
        bool "Enable local button"
        default y
        help
            Single momentary button. Press while running = OFF; hold ~1 s and
            release while off = ON; hold ~5 s = BLE pairing; keep holding = factory reset.

    config PUMP_BUTTON_GPIO
        int "Button GPIO"
        depends on PUMP_ENABLE_BUTTON
        range 0 21
        default 9
        help
            Active-low to GND. GPIO9 = SuperMini onboard BOOT button (wire an
            external button in parallel). Holding it at power-up enters download mode.

    config PUMP_BUTTON_ACTIVE_LOW
        bool "Buttons are active low"
        depends on PUMP_ENABLE_BUTTON
        default y
        help
            Buttons to GND with internal pull-up (inverted).

    config PUMP_ACTION_HOLD_MS
        int "Hold button then release to start pump (ms)"
        depends on PUMP_ENABLE_BUTTON
        range 200 5000
        default 1000
        help
            While the pump is off: hold at least this long, then release, to turn ON.
            Center LED fills while held.

    config PUMP_PAIRING_HOLD_MS
        int "Hold button to enter BLE pairing (ms)"
        depends on PUMP_ENABLE_BUTTON
        range 1000 15000
        default 5000

    config PUMP_FACTORY_RESET_EXTRA_MS
        int "Extra hold after BLE pair for factory reset (ms)"
        depends on PUMP_ENABLE_BUTTON
        range 5000 60000
        default 10000
        help
            Keep holding the button after the 5s BLE-pair cue. Red progress
            fills for this long, then factory reset + reboot. Hard to trigger
            by accident (default 5s pair + 10s = 15s total).

    config PUMP_PAIRING_TIMEOUT_MS
        int "Pairing window timeout (ms)"
        range 10000 300000
        default 60000

    config PUMP_ENABLE_BUZZER
        bool "Enable buzzer"
        default y
        help
            Active buzzer on the kitchen-gas-alarm board (GPIO HIGH = on).

    config PUMP_BUZZER_GPIO
        int "Buzzer GPIO"
        depends on PUMP_ENABLE_BUZZER
        range 0 21
        default 21

    config PUMP_RELAY_START_GPIO
        int "Starter relay A / START GPIO (−1 = unassigned)"
        range -1 21
        default 0
        help
            Two-button starter START (relay COM+NO across starter Start button).
            GPIO0: not a strap pin, floats at reset → relay stays off during boot.

    config PUMP_RELAY_STOP_GPIO
        int "Starter relay B / STOP GPIO (−1 = unassigned)"
        range -1 21
        default 1
        help
            Two-button starter STOP (relay COM+NC in series with starter Stop button).
            GPIO1: not a strap pin, floats at reset → relay stays off during boot.

    config PUMP_ENABLE_RTC
        bool "Enable DS3231 real-time clock (I2C)"
        default y
        help
            Keeps schedule time and the tank's last-seen time across restarts.
            Soft-fails if the chip is not wired.

    config PUMP_RTC_SDA_GPIO
        int "DS3231 SDA GPIO"
        depends on PUMP_ENABLE_RTC
        range 0 21
        default 7

    config PUMP_RTC_SCL_GPIO
        int "DS3231 SCL GPIO"
        depends on PUMP_ENABLE_RTC
        range 0 21
        default 6

    config PUMP_ENABLE_LORA
        bool "Enable RA-02 LoRa (tank link)"
        default y

    config PUMP_LORA_SCK_GPIO
        int "LoRa SCK GPIO"
        depends on PUMP_ENABLE_LORA
        default 10

    config PUMP_LORA_MOSI_GPIO
        int "LoRa MOSI GPIO"
        depends on PUMP_ENABLE_LORA
        default 3

    config PUMP_LORA_MISO_GPIO
        int "LoRa MISO GPIO"
        depends on PUMP_ENABLE_LORA
        default 2

    config PUMP_LORA_CS_GPIO
        int "LoRa NSS/CS GPIO"
        depends on PUMP_ENABLE_LORA
        default 5

    config PUMP_LORA_RST_GPIO
        int "LoRa RESET GPIO"
        depends on PUMP_ENABLE_LORA
        default 4

    config PUMP_LORA_DIO0_GPIO
        int "LoRa DIO0 GPIO"
        depends on PUMP_ENABLE_LORA
        default 8

    config PUMP_LORA_FREQ_HZ
        int "LoRa frequency (Hz)"
        depends on PUMP_ENABLE_LORA
        default 433000000

    config PUMP_TANK_PAIR_TIMEOUT_MS
        int "Tank LoRa pair window (ms)"
        depends on PUMP_ENABLE_LORA
        range 10000 300000
        default 60000

    config PUMP_TANK_STALE_SEC
        int "Tank offline after no packet (seconds)"
        depends on PUMP_ENABLE_LORA
        range 10 7200
        default 1500
        help
            Mark tank out of range if no LoRa packet within this window
            (about 2.5× the default 600s heartbeat).

    config PUMP_RELAY_ACTIVE_HIGH
        bool "Relays active high"
        default n
        help
            GPIO HIGH energizes the relay. Leave OFF for the common opto-isolated
            relay modules (IN LOW = relay ON), wired with JD-VCC jumper removed,
            input VCC = 3V3, JD-VCC = 5V.

    config PUMP_RELAY_PULSE_MS
        int "Start/Stop pulse width (ms)"
        range 50 2000
        default 1000
        help
            How long Start/Stop relays stay closed for a two-button starter.

endmenu
```
